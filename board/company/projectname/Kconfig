## board/company/projectname/Kconfig
```kconfig
if TARGET_PROJECTNAME

config SYS_BOARD
	default "projectname"

config SYS_VENDOR
	default "company"

config SYS_CONFIG_NAME
	default "projectname"

endif
```

## board/lytx/mx6lytx/Kconfig
```kconfig
if TARGET_MX6LYTX

config SYS_BOARD
	default "mx6lytx"

config SYS_VENDOR
	default "lytx"

config SYS_CONFIG_NAME
	default "mx6lytx"

endif
```
